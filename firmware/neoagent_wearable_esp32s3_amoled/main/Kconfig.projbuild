## firmware/neoagent_wearable_esp32s3_amoled/main/Kconfig.projbuild
```kconfig
menu "NeoAgent Wearable Configuration"

    config ESP_ENABLE_DHCP_CAPTIVEPORTAL
        bool "Enable DHCP captive portal URI"
        default y
        help
            Advertise the wearable setup page through DHCP option 114 so phones can
            open the portal automatically after joining the setup hotspot.

    config NEOAGENT_DISPLAY_TIMEOUT_SECONDS
        int "Display standby timeout in seconds"
        range 10 300
        default 30
        help
            Turn off the AMOLED after this period without touch or button input.
            Voice capture and playback keep the display awake. Networking remains
            connected so the wearable wakes without a full reboot.

    config NEOAGENT_AUTO_OTA
        bool "Automatically install firmware releases"
        default y
        help
            Periodically query the paired NeoAgent server for the latest GitHub
            release on the selected stable or beta channel. When a newer release
            is available, download its firmware asset over HTTPS and reboot into it.

    config NEOAGENT_AUTO_OTA_INITIAL_DELAY_SECONDS
        int "Initial automatic update delay in seconds"
        depends on NEOAGENT_AUTO_OTA
        range 30 900
        default 90

    config NEOAGENT_AUTO_OTA_CHECK_INTERVAL_MINUTES
        int "Automatic update check interval in minutes"
        depends on NEOAGENT_AUTO_OTA
        range 5 1440
        default 60

    config NEOAGENT_AUTO_OTA_MIN_BATTERY_PERCENT
        int "Minimum battery percentage for automatic updates"
        depends on NEOAGENT_AUTO_OTA
        range 10 80
        default 30
        help
            Automatic updates wait while the measured battery is below this
            value unless external power is connected. Manual updates remain available.

endmenu
```

## firmware/neoagent_wearable_esp32s3_amoled/sdkconfig.defaults
```kconfig
CONFIG_ESPTOOLPY_FLASHSIZE_16MB=y
CONFIG_PARTITION_TABLE_CUSTOM=y
CONFIG_PARTITION_TABLE_CUSTOM_FILENAME="partitions.csv"
CONFIG_PARTITION_TABLE_FILENAME="partitions.csv"
CONFIG_NVS_ENCRYPTION=n
CONFIG_COMPILER_OPTIMIZATION_PERF=y
CONFIG_SPIRAM=y
CONFIG_SPIRAM_MODE_OCT=y
CONFIG_SPIRAM_FETCH_INSTRUCTIONS=y
CONFIG_SPIRAM_RODATA=y
CONFIG_SPIRAM_SPEED_80M=y
CONFIG_ESP_DEFAULT_CPU_FREQ_MHZ_240=y
CONFIG_ESP_MAIN_TASK_STACK_SIZE=12288
CONFIG_HTTPD_MAX_REQ_HDR_LEN=2048
CONFIG_ESP_HTTP_CLIENT_ENABLE_HTTPS=y
CONFIG_MBEDTLS_CERTIFICATE_BUNDLE=y
CONFIG_ESP_TLS_USING_MBEDTLS=y
CONFIG_ESP_WIFI_SOFTAP_SUPPORT=y
CONFIG_ESP_ENABLE_DHCP_CAPTIVEPORTAL=y
CONFIG_NEOAGENT_DISPLAY_TIMEOUT_SECONDS=30
CONFIG_NEOAGENT_AUTO_OTA=y
CONFIG_NEOAGENT_AUTO_OTA_INITIAL_DELAY_SECONDS=90
CONFIG_NEOAGENT_AUTO_OTA_CHECK_INTERVAL_MINUTES=60
CONFIG_NEOAGENT_AUTO_OTA_MIN_BATTERY_PERCENT=30
CONFIG_BOOTLOADER_APP_ROLLBACK_ENABLE=y
CONFIG_FREERTOS_HZ=1000
CONFIG_LV_MEM_CUSTOM=y
CONFIG_LV_MEMCPY_MEMSET_STD=y
CONFIG_LV_COLOR_16_SWAP=y
CONFIG_LV_USE_QRCODE=y
CONFIG_LV_FONT_MONTSERRAT_12=y
CONFIG_LV_FONT_MONTSERRAT_16=y
```

## firmware/neoagent_wearable_stickc_plus2/sdkconfig.defaults
```kconfig
CONFIG_IDF_TARGET="esp32"
CONFIG_ESPTOOLPY_FLASHSIZE_8MB=y
CONFIG_PARTITION_TABLE_SINGLE_APP_LARGE=y
CONFIG_SPIRAM=y
CONFIG_SPIRAM_USE_MALLOC=y
CONFIG_SPIRAM_SPEED_40M=y
CONFIG_ESP_DEFAULT_CPU_FREQ_MHZ_160=y
CONFIG_PM_ENABLE=y
CONFIG_FREERTOS_USE_TICKLESS_IDLE=y
CONFIG_ESP_MAIN_TASK_STACK_SIZE=8192
CONFIG_HTTPD_MAX_REQ_HDR_LEN=2048
CONFIG_ESP_HTTP_CLIENT_ENABLE_HTTPS=y
CONFIG_MBEDTLS_CERTIFICATE_BUNDLE=y
CONFIG_ESP_WIFI_SOFTAP_SUPPORT=y
CONFIG_FREERTOS_HZ=1000
CONFIG_LV_MEM_CUSTOM=y
CONFIG_LV_COLOR_16_SWAP=y
CONFIG_LV_USE_QRCODE=y
CONFIG_LV_FONT_MONTSERRAT_12=y
CONFIG_LV_FONT_MONTSERRAT_16=y
CONFIG_COMPILER_OPTIMIZATION_SIZE=y
# CONFIG_ESP_WIFI_IRAM_OPT is not set
# CONFIG_ESP_WIFI_RX_IRAM_OPT is not set
```
